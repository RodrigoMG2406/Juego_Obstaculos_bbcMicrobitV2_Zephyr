## build/Kconfig/arch/Kconfig
```kconfig
# Load Zephyr Arch Kconfig descriptions.
osource "/home/mec/zephyrproject/zephyr/arch/rx/Kconfig"
osource "/home/mec/zephyrproject/zephyr/arch/x86/Kconfig"
osource "/home/mec/zephyrproject/zephyr/arch/xtensa/Kconfig"
osource "/home/mec/zephyrproject/zephyr/arch/sparc/Kconfig"
osource "/home/mec/zephyrproject/zephyr/arch/riscv/Kconfig"
osource "/home/mec/zephyrproject/zephyr/arch/posix/Kconfig"
osource "/home/mec/zephyrproject/zephyr/arch/mips/Kconfig"
osource "/home/mec/zephyrproject/zephyr/arch/arm64/Kconfig"
osource "/home/mec/zephyrproject/zephyr/arch/arm/Kconfig"
osource "/home/mec/zephyrproject/zephyr/arch/arc/Kconfig"
```

## build/Kconfig/boards/Kconfig
```kconfig
# Load Zephyr board Kconfig descriptions.
osource "/home/mec/zephyrproject/zephyr/boards/bbc/microbit_v2/Kconfig"
```

## build/Kconfig/boards/Kconfig.bbc_microbit_v2
```kconfig
# Load board Kconfig descriptions.
osource "/home/mec/zephyrproject/zephyr/boards/bbc/microbit_v2/Kconfig.bbc_microbit_v2"
```

## build/Kconfig/boards/Kconfig.defconfig
```kconfig
# Load Zephyr board defconfig descriptions.
osource "/home/mec/zephyrproject/zephyr/boards/bbc/microbit_v2/Kconfig.defconfig"
```
